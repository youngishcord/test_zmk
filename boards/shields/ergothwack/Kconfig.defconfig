## boards/shields/ergothwack/Kconfig.defconfig
```kconfig
if SHIELD_ERGOTHWACK_RIGHT

config ZMK_KEYBOARD_NAME
    default "ergoTHWACK"

config ZMK_SPLIT_ROLE_CENTRAL
    default y

config I2C
    default y

endif

if SHIELD_ERGOTHWACK_LEFT || SHIELD_ERGOTHWACK_RIGHT

config ZMK_SPLIT
    default y

endif
```

## boards/shields/ergothwack/Kconfig.shield
```kconfig
config SHIELD_ERGOTHWACK_LEFT
    def_bool $(shields_list_contains,ergothwack_left)

config SHIELD_ERGOTHWACK_RIGHT
    def_bool $(shields_list_contains,ergothwack_right)
```

## config/boards/shields/jellysplit/Kconfig.shield
```kconfig
config SHIELD_JELLYSPLIT_LEFT
    def_bool $(shields_list_contains,jellysplit_left)

config SHIELD_JELLYSPLIT_RIGHT
    def_bool $(shields_list_contains,jellysplit_right)
```

## config/west.yml
```yaml
manifest:
  remotes:
    - name: zmkfirmware
      url-base: https://github.com/zmkfirmware
    - name: inorichi
      url-base: https://github.com/inorichi
    - name: petejohanson
      url-base: https://github.com/petejohanson
  projects:
    - name: zmk-pmw3610-driver
      remote: inorichi
      revision: main
    - name: zmk
      remote: petejohanson
      revision: power/domains-and-device-runtime
      import: app/west.yml
  self:
    path: config
```
